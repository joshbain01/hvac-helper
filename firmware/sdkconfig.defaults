## firmware/sdkconfig.defaults
```kconfig
# Custom Partition Table Setup
CONFIG_PARTITION_TABLE_CUSTOM=y
CONFIG_PARTITION_TABLE_CUSTOM_FILENAME="partitions.csv"
CONFIG_PARTITION_TABLE_FILENAME="partitions.csv"

# Flash Size configuration (8MB)
CONFIG_ESPTOOLPY_FLASHSIZE_8MB=y
CONFIG_ESPTOOLPY_FLASHSIZE="8MB"

# Compiler Optimization (Optimize for size to fit 1.5MB OTA limits)
CONFIG_COMPILER_OPTIMIZATION_SIZE=y
CONFIG_COMPILER_OPTIMIZATION_ASSERTIONS_DISABLE=y

# FreeRTOS Stack checking
CONFIG_FREERTOS_CHECK_STACK_OVERFLOW_CANARY=y
CONFIG_FREERTOS_WATCHDOG=y
CONFIG_FREERTOS_TASK_FUNCTION_WRAPPER=y

# Bluetooth configuration (NimBLE Stack)
CONFIG_BT_ENABLED=y
CONFIG_BT_NIMBLE_ENABLED=y
CONFIG_BT_NIMBLE_MAX_CONNECTIONS=1
CONFIG_BT_NIMBLE_ROLE_PERIPHERAL=y
CONFIG_BT_NIMBLE_ROLE_CENTRAL=n
CONFIG_BT_NIMBLE_ROLE_OBSERVER=n
CONFIG_BT_NIMBLE_ROLE_BROADCASTER=n

# Power management and sleep caching
CONFIG_PM_ENABLE=y
CONFIG_PM_DFS_INIT_CONFIG=y
```
